## linux/fs/bytefs/Kconfig
```kconfig
config BYTEFS_FS
	tristate "BYTEFS: ByteFS"
	depends on FS_DAX
	depends on LIBNVDIMM
	select CRC32
	select LIBCRC32C
	help
	  Say Y here.

	  To compile this as a module, choose M here: the module will be
	  called bytefs.

	  If unsure, say N.
```

## linux/fs/pmfs/Kconfig
```kconfig
config PMFS
	tristate "Persistent and Protected PM file system support"
	depends on HAS_IOMEM
	select CRC16
	help
	   If your system has a block of fast (comparable in access speed to
	   system memory) and non-volatile byte-addressable memory and you wish to
	   mount a light-weight, full-featured, and space-efficient filesystem over
	   it, say Y here, and read <file:Documentation/filesystems/pmfs.txt>.

	   To compile this as a module,  choose M here: the module will be
	   called pmfs.

config PMFS_XIP
	bool "Execute-in-place in PMFS"
	depends on PMFS && BLOCK
	help
	   Say Y here to enable XIP feature of PMFS.
```
